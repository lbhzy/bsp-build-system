## Config.in
```kconfig
mainmenu "BSP Configuration"

choice
prompt "Target Architecture"
    config ARCH_ARM
        bool "arm"

    config ARCH_AARCH64
        bool "aarch64"

    config ARCH_RISCV
        bool "riscv"

    config ARCH_X86
        bool "x86"
endchoice


menu "Toolchain"
    config TOOLCHAIN_PATH
        string "Toolchain path"

    config TOOLCHAIN_PREFIX
        string "Toolchain prefix"
endmenu


menu "Loader"
    config DEFCONFIG
        bool "Use U-Boot as bootloader"
        default y
endmenu


menu "U-Boot"
    config UBOOT_DEFCONFIG
        string "Default configuration"
endmenu


menu "Linux Kernel"
    config KERNEL_DEFCONFIG
        string "Default configuration"
endmenu


menu "Root Filesystem"
    choice
    prompt "Skeleton"
        config ROOTFS_SKELETON_BR
            bool "Buildroot"

        config ROOTFS_SKELETON_CUSTOM
            bool "Custom (base on busybox)"

        config ROOTFS_SKELETON_TOYBOX
            bool "Toybox"
    endchoice

    config BUSYBOX_DEFCONFIG
        string "Busybox defconfig name"
        depends on ROOTFS_SKELETON_CUSTOM

    config BUILDROOT_DEFCONFIG
        string "Buildroot defconfig name"
        depends on ROOTFS_SKELETON_BR

    config TOYBOX_DEFCONFIG
        string "Toybox defconfig name"
        depends on ROOTFS_SKELETON_TOYBOX

    comment "Root filesystem images"
    
    config ROOTFS_IMAGE_CPIO
        bool "cpio (initramfs)"
        default y
    
    config ROOTFS_IMAGE_SQUASHFS
        bool "squashfs"
    
    config ROOTFS_IMAGE_TAR
        bool "tar"
        default y
    
    config ROOTFS_IMAGE_EXT4
        bool "ext4"
endmenu


menu "Application"
    config APP_4G
        bool "4G function"
        default y
    
    config APP_LOGSAVE
        bool "Logsave function"
        default y

    config APP_P2P
        bool "P2P function"
        default y
endmenu


menu "Pack image"
endmenu
```

## configs/qemu_aarch64_defconfig
```kconfig
CONFIG_ARCH_AARCH64=y
CONFIG_TOOLCHAIN_PATH="/home/ozzy/bsp-build-system/rootfs/buildroot/output/host/bin/"
CONFIG_TOOLCHAIN_PREFIX="aarch64-buildroot-linux-gnu-"
CONFIG_UBOOT_DEFCONFIG="qemu_arm64_defconfig"
CONFIG_KERNEL_DEFCONFIG="my_defconfig"
CONFIG_ROOTFS_SKELETON_CUSTOM=y
CONFIG_BUSYBOX_DEFCONFIG="my_defconfig"
```
